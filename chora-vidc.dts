// SPDX-License-Identifier: BSD-3-Clause
/*
 * Copyright (c) Qualcomm Technologies, Inc. and/or its subsidiaries.
 */

/dts-v1/;
/plugin/;

#include <dt-bindings/interrupt-controller/arm-gic.h>
#include <dt-bindings/clock/qcom,chora-gcc.h>
#include <dt-bindings/interconnect/qcom,chora.h>
#include <dt-bindings/clock/qcom,chora-videocc.h>
#include "chora-vidc.dtsi"

/ {
	model = "Qualcomm Technologies, Inc. chora";
	compatible = "qcom,chora";
	qcom,msm-id = <724 0x10000>, <744 0x10000>,
			<0x10002D4 0x10000>, <0x10002E8 0x10000>;
	qcom,board-id = <0 0>;
};
